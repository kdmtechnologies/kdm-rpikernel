## arch/arm/configs/bcm2711_defconfig
```kconfig
CONFIG_DRM_PANEL_RAYDIUM_RM67191=y
CONFIG_TOUCHSCREEN_GOODIX_GTX8=m
CONFIG_TOUCHSCREEN_GOODIX_GTX8_UPDATE=y
CONFIG_TOUCHSCREEN_GOODIX_GTX8_GESTURE=y
CONFIG_TOUCHSCREEN_GOODIX_GTX8_TOOLS=y
```
